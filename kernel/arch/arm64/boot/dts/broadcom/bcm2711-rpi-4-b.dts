#include "../../../../arm/boot/dts/bcm2711-rpi-4-b.dts"

/ {
    leds {
        compatible = "arpi4,leds";

        gpio18_led {
            label = "gpio18_led";
            gpios = <&gpio 18 GPIO_ACTIVE_HIGH>;
			default-trigger = "heartbeat";
        };
    };
};